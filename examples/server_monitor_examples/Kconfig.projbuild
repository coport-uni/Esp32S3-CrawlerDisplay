## examples/server_monitor_examples/Kconfig.projbuild
```kconfig
menu "Beszel monitor"

config BESZEL_WIFI_SSID
    string "WiFi SSID"
    default ""
    help
        WPA2-Personal SSID. Leave empty to skip WiFi bring-up; the
        Beszel tab will show a "configure WiFi" message.

config BESZEL_WIFI_PASSWORD
    string "WiFi password"
    default ""
    help
        WPA2-Personal passphrase. Stored in the local sdkconfig only.

config BESZEL_SERVER_URL
    string "Beszel base URL"
    default "http://10.16.21.197:8090"
    help
        Base URL of the Beszel/PocketBase server. Include scheme and
        port. Trailing slash optional.

config BESZEL_USER
    string "Beszel identity"
    default ""
    help
        Beszel user identity (typically the email address). Used in
        POST /api/collections/users/auth-with-password.

config BESZEL_PASSWORD
    string "Beszel password"
    default ""
    help
        Beszel user password. Stored in the local sdkconfig only.

config BESZEL_POLL_INTERVAL_S
    int "Poll interval (seconds)"
    default 5
    range 2 60
    help
        How often to poll /api/collections/systems/records.

config BESZEL_MAX_HOSTS
    int "Max hosts cached"
    default 16
    range 1 50
    help
        Upper bound on number of hosts kept in the on-device cache.

endmenu
```

## sdkconfig.defaults
```kconfig
# 칩 타깃
CONFIG_IDF_TARGET="esp32s3"

# 16MB 플래시
CONFIG_ESPTOOLPY_FLASHSIZE_16MB=y
CONFIG_ESPTOOLPY_FLASHSIZE="16MB"
CONFIG_PARTITION_TABLE_SINGLE_APP_LARGE=y

# Octal PSRAM (BOX-3는 16MB Octal)
CONFIG_SPIRAM=y
CONFIG_SPIRAM_MODE_OCT=y
CONFIG_SPIRAM_SPEED_80M=y
CONFIG_SPIRAM_USE_MALLOC=y

# CPU 클럭 240MHz
CONFIG_ESP_DEFAULT_CPU_FREQ_MHZ_240=y

# LVGL 더블 버퍼링용 메모리
CONFIG_LV_MEM_CUSTOM=y
CONFIG_LV_MEMCPY_MEMSET_STD=y

# USB-Serial JTAG 콘솔
CONFIG_ESP_CONSOLE_USB_SERIAL_JTAG=y
```
